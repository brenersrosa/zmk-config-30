## boards/shields/unido/Kconfig.defconfig
```kconfig
# boards/shields/unido/Kconfig.defconfig
if SHIELD_UNIDO
config ZMK_KEYBOARD_NAME
    default "Unido"
endif
```

## boards/shields/unido/Kconfig.shield
```kconfig
# boards/shields/unido/Kconfig.shield
config SHIELD_UNIDO
    def_bool $(shields_list_contains,unido)
```
